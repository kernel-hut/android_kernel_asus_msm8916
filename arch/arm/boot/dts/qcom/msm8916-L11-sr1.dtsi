// ASUS_BSP Deeo : copy from msm8916-regulator.dtsi

/* L11 regulators */
&rpm_bus {
	rpm-regulator-ldoa11 {
		status = "okay";
		pm8916_l11: regulator-l11 {
			regulator-min-microvolt = <1800000>;
			regulator-max-microvolt = <2950000>;
			qcom,init-voltage = <1800000>;
			status = "okay";
		};
	};
};
