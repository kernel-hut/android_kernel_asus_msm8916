/* Copyright (c) 2013, The Linux Foundation. All rights reserved.
 *
 * This program is free software; you can redistribute it and/or modify
 * it under the terms of the GNU General Public License version 2 and
 * only version 2 as published by the Free Software Foundation.
 *
 * This program is distributed in the hope that it will be useful,
 * but WITHOUT ANY WARRANTY; without even the implied warranty of
 * MERCHANTABILITY or FITNESS FOR A PARTICULAR PURPOSE.  See the
 * GNU General Public License for more details.
 */

/*---------------------------------------------------------------------------
 * This file is autogenerated file using gcdb parser. Please do not edit it.
 * Update input XML file to add a new entry or update variable in this file
 * VERSION = "1.0"
 *---------------------------------------------------------------------------*/
&mdss_mdp {
	dsi_auo_rm68200_720p_video: qcom,mdss_dsi_auo_rm68200_720p_video {
		qcom,mdss-dsi-panel-name = "auo 720p video mode dsi panel";
		qcom,mdss-dsi-panel-controller = <&mdss_dsi0>;
		qcom,ulps-enabled;
		qcom,suspend-ulps-enabled;
		qcom,mdss-dsi-panel-type = "dsi_video_mode";
		qcom,mdss-dsi-panel-destination = "display_1";
		qcom,mdss-dsi-panel-framerate = <60>;
		qcom,mdss-dsi-virtual-channel-id = <0>;
		qcom,mdss-dsi-stream = <0>;
		qcom,mdss-dsi-panel-width = <720>;
		qcom,mdss-dsi-panel-height = <1280>;
                qcom,mdss-dsi-h-front-porch = <53>;
                qcom,mdss-dsi-h-back-porch = <64>;
		qcom,mdss-dsi-h-pulse-width = <4>;
		qcom,mdss-dsi-h-sync-skew = <0>;
		qcom,mdss-dsi-v-back-porch = <16>;
		qcom,mdss-dsi-v-front-porch = <16>;
		qcom,mdss-dsi-v-pulse-width = <4>;
		qcom,mdss-dsi-h-left-border = <0>;
		qcom,mdss-dsi-h-right-border = <0>;
		qcom,mdss-dsi-v-top-border = <0>;
		qcom,mdss-dsi-v-bottom-border = <0>;
		qcom,mdss-dsi-bpp = <24>;
		qcom,mdss-dsi-color-order = "rgb_swap_rgb";
		qcom,mdss-dsi-underflow-color = <0xff>;
		qcom,mdss-dsi-border-color = <0>;
		qcom,mdss-dsi-on-command = [15 01 00 00 00 00 02 FE 04
				15 01 00 00 00 00 02 5F 0A
				15 01 00 00 00 00 02 60 09
				15 01 00 00 00 00 02 61 11
				15 01 00 00 00 00 02 62 18
				15 01 00 00 00 00 02 63 09
				15 01 00 00 00 00 02 64 03
				15 01 00 00 00 00 02 65 0F
				15 01 00 00 00 00 02 66 10
				15 01 00 00 00 00 02 67 0D
				15 01 00 00 00 00 02 68 15
				15 01 00 00 00 00 02 69 0B
				15 01 00 00 00 00 02 6A 0D
				15 01 00 00 00 00 02 6B 07
				15 01 00 00 00 00 02 6C 0F
				15 01 00 00 00 00 02 6D 11
				15 01 00 00 00 00 02 6E 0E
				15 01 00 00 00 00 02 6F 09
				15 01 00 00 00 00 02 70 09
				15 01 00 00 00 00 02 71 11
				15 01 00 00 00 00 02 72 18
				15 01 00 00 00 00 02 73 09
				15 01 00 00 00 00 02 74 03
				15 01 00 00 00 00 02 75 0F
				15 01 00 00 00 00 02 76 10
				15 01 00 00 00 00 02 77 0D
				15 01 00 00 00 00 02 78 15
				15 01 00 00 00 00 02 79 0B
				15 01 00 00 00 00 02 7A 0D
				15 01 00 00 00 00 02 7B 07
				15 01 00 00 00 00 02 7C 0F
				15 01 00 00 00 00 02 7D 11
				15 01 00 00 00 00 02 7E 0E
				15 01 00 00 00 00 02 7F 09
				15 01 00 00 00 00 02 1C 33
				15 01 00 00 00 00 02 1D 44
				15 01 00 00 00 00 02 1E 55
				15 01 00 00 00 00 02 1F 67
				15 01 00 00 00 00 02 20 89
				15 01 00 00 00 00 02 21 AB
				15 01 00 00 00 00 02 0A 62
				15 01 00 00 00 00 02 15 FE
				15 01 00 00 00 00 02 27 5B
				15 01 00 00 00 00 02 FE 00
                                15 01 00 00 00 00 02 5E 0C
                                15 01 00 00 00 00 02 51 00
				15 01 00 00 00 00 02 53 24
				15 01 00 00 00 00 02 55 00
				05 01 00 00 96 00 02 11 00
				05 01 00 00 00 00 02 29 00];
		qcom,mdss-dsi-off-command = [15 01 00 00 32 00 02 28 00
					15 01 00 00 78 00 02 10 00];
		qcom,mdss-dsi-on-command-state = "dsi_lp_mode";
		qcom,mdss-dsi-off-command-state = "dsi_hs_mode";
		qcom,mdss-dsi-h-sync-pulse = <1>;
		qcom,mdss-dsi-traffic-mode = "burst_mode";
		qcom,mdss-dsi-lane-map = "lane_map_0123";
		qcom,mdss-dsi-bllp-eof-power-mode;
		qcom,mdss-dsi-bllp-power-mode;
		qcom,mdss-dsi-lane-0-state;
		qcom,mdss-dsi-lane-1-state;
		qcom,mdss-dsi-lane-2-state;
		qcom,mdss-dsi-lane-3-state;
		qcom,mdss-dsi-panel-timings = [75 18 10 00 3A 3E 14 1A 13 03 04 00];
		qcom,mdss-dsi-t-clk-post = <0x2c>;
		qcom,mdss-dsi-t-clk-pre = <0x20>;
		qcom,mdss-dsi-bl-min-level = <1>;
		qcom,mdss-dsi-bl-max-level = <255>;
		qcom,mdss-dsi-dma-trigger = "trigger_sw";
		qcom,mdss-dsi-mdp-trigger = "none";
		qcom,mdss-dsi-bl-pmic-control-type = "bl_ctrl_dcs";
		qcom,mdss-dsi-reset-sequence = <1 10>, <0 10>, <1 10>;
                qcom,mdss-pan-physical-width-dimension = <62>; //width of picture in mm (for xdpi)
                qcom,mdss-pan-physical-height-dimension = <110>; //height of picture in mm (for ydpi)
	};
};
