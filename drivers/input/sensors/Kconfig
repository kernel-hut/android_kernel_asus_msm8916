## drivers/input/sensors/Kconfig
```kconfig
##
# ASUS G-Sensor & E-compass driver configuration
#

config SENSORS_AK09911
        tristate "AK09911 compass support"
        default n
        depends on I2C
        help
          If you say yes here you get support for Asahi Kasei's
          orientation sensor AK09911.

config SENSORS_KX022
        tristate "KX022 g-sensor sensor"
        depends on I2C
```

## drivers/input/touchscreen/Focal_ZC550KL/Kconfig
```kconfig
#
# Touchscreen driver configuration
#
#menuconfig INPUT_TOUCHSCREEN
#	bool "Touchscreens"
#	help
#	  Say Y here, and a list of supported touchscreens will be displayed.
#	  This option doesn't affect the kernel.

#	  If unsure, say Y.

if INPUT_TOUCHSCREEN

config TOUCHSCREEN_FT5X46_ZC550KL
       tristate "FocalTech touchscreens"
       depends on I2C
       help
         Say Y here if you have a ft5X06 touchscreen.
	 Ft5x06 controllers are multi touch controllers which can
	 report 5 touches at a time.

         If unsure, say N.

         To compile this driver as a module, choose M here: the
         module will be called ft5x06_ts.
endif
```

## drivers/sensors/ASH/Kconfig
```kconfig
menuconfig ASH
	bool "Enable Asus Sensor Hub Support"
	help
	  This is the driver for Asus Sensor Hub.
	  We support all sensors on the device.

if ASH
config ASHDEBUG
	bool "Enable Asus Sensor Hub Debug"
	help
	  This config is for Printing ASH debug log.
	  
config ASHTEST
	bool "Enable Asus Sensor Hub Test Driver"
	help
	  This is the Test Driver for Asu Sensor Hub.
	  You can add any code to test the ASH.

config IRSENSOR
	bool "Enable P/L Sensor Driver Support"
	depends on I2C && ASH
	help
	  This driver is used for exercising P/L sensor.
endif
```

## drivers/soundwire/Kconfig
```kconfig
#
# SOUNDWIRE driver configuration
#
menuconfig SOUNDWIRE
	bool "Soundwire support"
	help
	  Soundwire is a two wire interface for audio to connect
	  simple peripheral components in mobile devices.

if SOUNDWIRE
config SOUNDWIRE_WCD_CTRL
	tristate "QTI WCD CODEC Soundwire controller"
	default y
	help
	  Select driver for QTI's Soundwire Master Component.
endif
```
