/* Copyright (c) 2013, The Linux Foundation. All rights reserved.
 *
 * This program is free software; you can redistribute it and/or modify
 * it under the terms of the GNU General Public License version 2 and
 * only version 2 as published by the Free Software Foundation.
 *
 * This program is distributed in the hope that it will be useful,
 * but WITHOUT ANY WARRANTY; without even the implied warranty of
 * MERCHANTABILITY or FITNESS FOR A PARTICULAR PURPOSE.  See the
 * GNU General Public License for more details.
 */

/*---------------------------------------------------------------------------
 * This file is autogenerated file using gcdb parser. Please do not edit it.
 * Update input XML file to add a new entry or update variable in this file
 * VERSION = "1.0"
 *---------------------------------------------------------------------------*/
&mdss_mdp {
	dsi_boe_otm1284a_720p_video: qcom,mdss_dsi_boe_otm1284a_720p_video {
		qcom,mdss-dsi-panel-name = "boe 720p video mode dsi panel";
		qcom,mdss-dsi-panel-controller = <&mdss_dsi0>;
		qcom,ulps-enabled;
		qcom,suspend-ulps-enabled;
		qcom,mdss-dsi-panel-type = "dsi_video_mode";
		qcom,mdss-dsi-panel-destination = "display_1";
		qcom,mdss-dsi-panel-framerate = <60>;
		qcom,mdss-dsi-virtual-channel-id = <0>;
		qcom,mdss-dsi-stream = <0>;
		qcom,mdss-dsi-panel-width = <720>;
		qcom,mdss-dsi-panel-height = <1280>;
                qcom,mdss-dsi-h-front-porch = <53>;
                qcom,mdss-dsi-h-back-porch = <64>;
                qcom,mdss-dsi-h-pulse-width = <4>;
		qcom,mdss-dsi-h-sync-skew = <0>;
                qcom,mdss-dsi-v-back-porch = <16>;
                qcom,mdss-dsi-v-front-porch = <16>;
                qcom,mdss-dsi-v-pulse-width = <4>;
		qcom,mdss-dsi-h-left-border = <0>;
		qcom,mdss-dsi-h-right-border = <0>;
		qcom,mdss-dsi-v-top-border = <0>;
		qcom,mdss-dsi-v-bottom-border = <0>;
		qcom,mdss-dsi-bpp = <24>;
		qcom,mdss-dsi-color-order = "rgb_swap_rgb";
		qcom,mdss-dsi-underflow-color = <0xff>;
		qcom,mdss-dsi-border-color = <0>;
		qcom,mdss-dsi-on-command = [29 01 00 00 00 00 02 00 00
				29 01 00 00 00 00 04 FF 12 84 01
				29 01 00 00 00 00 02 00 80
				29 01 00 00 00 00 03 FF 12 84
                                29 01 00 00 00 00 02 00 80
                                29 01 00 00 00 00 02 B0 01
                                29 01 00 00 00 00 02 00 81
                                29 01 00 00 00 00 02 B0 11
                                29 01 00 00 00 00 02 00 82
                                29 01 00 00 00 00 02 B0 01
                                29 01 00 00 00 00 02 00 83
                                29 01 00 00 00 00 02 B0 41
                                29 01 00 00 00 00 02 00 84
                                29 01 00 00 00 00 02 B0 06
				29 01 00 00 00 00 02 00 91
				29 01 00 00 00 00 02 B0 9A
				29 01 00 00 00 00 02 00 92
				29 01 00 00 00 00 03 FF 30 02
				29 01 00 00 00 00 02 00 80
				29 01 00 00 00 00 0A C0 00 64 00 0F 11 00 64 0F 11
				29 01 00 00 00 00 02 00 90
				29 01 00 00 00 00 07 C0 00 5F 00 01 00 04
				29 01 00 00 00 00 02 00 A4
				29 01 00 00 00 00 02 C0 00
				29 01 00 00 00 00 02 00 B3
				29 01 00 00 00 00 03 C0 00 50
				29 01 00 00 00 00 02 00 81
				29 01 00 00 00 00 02 C1 55
				29 01 00 00 00 00 02 00 90
				29 01 00 00 00 00 05 F5 02 11 02 15
				29 01 00 00 00 00 02 00 90
				29 01 00 00 00 00 02 C5 50
				29 01 00 00 00 00 02 00 94
				29 01 00 00 00 00 02 C5 66
				29 01 00 00 00 00 02 00 B2
				29 01 00 00 00 00 03 F5 00 00
				29 01 00 00 00 00 02 00 B4
				29 01 00 00 00 00 03 F5 00 00
				29 01 00 00 00 00 02 00 B6
				29 01 00 00 00 00 03 F5 00 00
				29 01 00 00 00 00 02 00 B8
				29 01 00 00 00 00 03 F5 00 00
				29 01 00 00 00 00 02 00 B4
				29 01 00 00 00 00 02 C5 CC
				29 01 00 00 00 00 02 00 A0
				29 01 00 00 00 00 0F C4 05 10 06 02 05 15 10 05 10 07 02 05 15 10
				29 01 00 00 00 00 02 00 B0
				29 01 00 00 00 00 03 C4 00 00
				29 01 00 00 00 00 02 00 91
				29 01 00 00 00 00 03 C5 19 52
				29 01 00 00 00 00 02 00 00
				29 01 00 00 00 00 03 D8 C7 C7
				29 01 00 00 00 00 02 00 B3
				29 01 00 00 00 00 02 C5 84
				29 01 00 00 00 00 02 00 BB
				29 01 00 00 00 00 02 C5 8A
				29 01 00 00 00 00 02 00 B2
				29 01 00 00 00 00 02 C5 40
				29 01 00 00 00 00 02 00 81
				29 01 00 00 00 00 03 C4 82 0A
				29 01 00 00 00 00 02 00 C6
				29 01 00 00 00 00 02 B0 03
				29 01 00 00 00 00 02 00 00
				29 01 00 00 00 00 15 E1 0C 10 1D 22 38 3E 3E 65 53 6D 96 80 8E 67 64 61 4E 25 1B 04
				29 01 00 00 00 00 02 00 00
				29 01 00 00 00 00 15 E2 00 0F 12 21 23 36 37 64 5A 75 8A 74 86 5A 58 29 2E 25 1B 04
				29 01 00 00 00 00 02 00 80
				29 01 00 00 00 00 1D CA 80 79 82 8b 94 9d a6 af b8 c0 c9 d2 db e4 ed f6 9f ff 9f ff 70 ff 05 03 05 03 05 03
				29 01 00 00 00 00 02 00 00
				29 01 00 00 00 00 02 C6 10
				29 01 00 00 00 00 13 C7 d0 ba ab cd b9 dc ba bb bc 88 88 67 45 44 44 44 33 33
				29 01 00 00 00 00 02 00 00
				29 01 00 00 00 00 02 C6 11
				29 01 00 00 00 00 13 C7 c0 ba ab cb b9 cc a9 ac cb 88 88 78 45 44 44 44 44 44
				29 01 00 00 00 00 02 00 00
				29 01 00 00 00 00 02 C6 12
				29 01 00 00 00 00 13 C7 c0 c9 9a cb 99 cc aa ba ba 88 88 78 56 55 55 44 44 44
				29 01 00 00 00 00 02 00 00
				29 01 00 00 00 00 02 C6 13
				29 01 00 00 00 00 13 C7 c0 b8 aa ca 99 cb 9a aa ba 88 88 78 56 55 55 55 55 45
				29 01 00 00 00 00 02 00 00
				29 01 00 00 00 00 02 C6 14
				29 01 00 00 00 00 13 C7 b0 a9 9a bb 99 ba 9b a9 aa 88 88 88 67 56 55 55 55 55
				29 01 00 00 00 00 02 00 00
				29 01 00 00 00 00 02 C6 15
				29 01 00 00 00 00 13 C7 b0 a8 9a c9 a8 ba 99 b9 9a 88 88 88 67 66 66 56 55 55
				29 01 00 00 00 00 02 00 00
				29 01 00 00 00 00 02 C6 16
				29 01 00 00 00 00 13 C7 b0 a8 99 b9 8a aa a9 a8 b9 88 88 88 67 66 66 66 66 55
				29 01 00 00 00 00 02 00 00
				29 01 00 00 00 00 02 C6 17
				29 01 00 00 00 00 13 C7 a0 a8 99 b9 98 b9 99 99 a9 88 88 88 78 66 66 66 66 66
				29 01 00 00 00 00 02 00 00
				29 01 00 00 00 00 02 C6 18
				29 01 00 00 00 00 13 C7 a0 a8 99 b8 88 a9 9a 89 9a 88 88 88 78 77 67 66 66 66
				29 01 00 00 00 00 02 00 00
				29 01 00 00 00 00 02 C6 19
				29 01 00 00 00 00 13 C7 a0 98 99 a8 89 a8 9a 98 99 88 88 88 78 77 77 77 66 66
				29 01 00 00 00 00 02 00 00
				29 01 00 00 00 00 02 C6 1a
				29 01 00 00 00 00 13 C7 a0 9a 99 99 88 a9 98 88 99 88 88 88 78 88 77 77 77 77
				29 01 00 00 00 00 02 00 00
				29 01 00 00 00 00 02 C6 1b
				29 01 00 00 00 00 13 C7 a0 9a 99 99 88 a8 98 88 99 88 88 88 88 78 77 77 77 77
				29 01 00 00 00 00 02 00 00
				29 01 00 00 00 00 02 C6 1c
				29 01 00 00 00 00 13 C7 a0 aa 99 98 88 98 98 88 89 88 88 88 88 88 88 77 77 77
				29 01 00 00 00 00 02 00 00
				29 01 00 00 00 00 02 C6 1d
				29 01 00 00 00 00 13 C7 a0 aa 99 88 89 98 88 88 89 88 88 88 88 88 77 77 77 77
				29 01 00 00 00 00 02 00 00
				29 01 00 00 00 00 02 C6 1e
				29 01 00 00 00 00 13 C7 a0 aa 89 88 89 88 88 88 88 88 88 88 88 88 88 88 77 77
				29 01 00 00 00 00 02 00 00
				29 01 00 00 00 00 02 C6 1f
				29 01 00 00 00 00 13 C7 a0 aa 89 88 88 88 88 88 88 88 88 88 88 88 88 88 77 77
				29 01 00 00 00 00 02 00 00
				29 01 00 00 00 00 02 C6 00
				29 01 00 00 00 00 02 00 80
				29 01 00 00 00 00 0C CB 00 00 00 00 00 00 00 00 00 00 00
				29 01 00 00 00 00 02 00 90
				29 01 00 00 00 00 10 CB 00 00 00 00 00 00 00 00 00 00 00 00 00 00 00
				29 01 00 00 00 00 02 00 A0
				29 01 00 00 00 00 10 CB 00 00 00 00 00 00 00 00 00 00 00 00 00 00 00
				29 01 00 00 00 00 02 00 B0
				29 01 00 00 00 00 10 CB 00 00 00 00 00 00 00 00 00 00 00 00 00 00 00
				29 01 00 00 00 00 02 00 C0
				29 01 00 00 00 00 10 CB 05 05 05 05 05 05 05 05 05 00 00 00 00 00 00
				29 01 00 00 00 00 02 00 D0
				29 01 00 00 00 00 10 CB 00 00 00 05 05 05 05 05 05 05 05 05 05 05 05
				29 01 00 00 00 00 02 00 E0
				29 01 00 00 00 00 0F CB 05 00 00 00 00 00 00 00 00 00 05 05 05 05
				29 01 00 00 00 00 02 00 F0
				29 01 00 00 00 00 0C CB FF FF FF FF FF FF FF FF FF FF FF
				29 01 00 00 00 00 02 00 80
				29 01 00 00 00 00 10 CC 2d 2d 0a 0c 0e 10 00 00 00 00 00 00 00 00 00
				29 01 00 00 00 00 02 00 90
				29 01 00 00 00 00 10 CC 00 00 00 2e 2e 02 04 2d 2d 09 0b 0d 0f 00 00
				29 01 00 00 00 00 02 00 A0
				29 01 00 00 00 00 0F CC 00 00 00 00 00 00 00 00 00 00 2e 2e 01 03
				29 01 00 00 00 00 02 00 B0
				29 01 00 00 00 00 10 CC 2d 2e 0f 0d 0b 09 00 00 00 00 00 00 00 00 00
				29 01 00 00 00 00 02 00 C0
				29 01 00 00 00 00 10 CC 00 00 00 2e 2d 03 01 2d 2e 10 0e 0c 0a 00 00
				29 01 00 00 00 00 02 00 D0
				29 01 00 00 00 00 0F CC 00 00 00 00 00 00 00 00 00 00 2e 2d 04 02
				29 01 00 00 00 00 02 00 80
				29 01 00 00 00 00 0D CE 8D 03 29 8C 03 29 8B 03 29 8A 03 29
				29 01 00 00 00 00 02 00 90
				29 01 00 00 00 00 0F CE 00 00 00 00 00 00 00 00 00 00 00 00 00 00
				29 01 00 00 00 00 02 00 A0
				29 01 00 00 00 00 0F CE 38 0B 8B 00 8d 29 00 38 0A 8B 01 8d 29 00
				29 01 00 00 00 00 02 00 B0
				29 01 00 00 00 00 0F CE 38 09 8B 02 8d 29 00 38 08 8B 03 8d 29 00
				29 01 00 00 00 00 02 00 C0
				29 01 00 00 00 00 0F CE 38 07 8B 04 8d 29 00 38 06 8B 05 8d 29 00
				29 01 00 00 00 00 02 00 D0
				29 01 00 00 00 00 0F CE 38 05 8B 06 8d 29 00 38 04 8B 07 8d 29 00
				29 01 00 00 00 00 02 00 80
				29 01 00 00 00 00 0F CF 00 00 00 00 00 00 00 00 00 00 00 00 00 00
				29 01 00 00 00 00 02 00 90
				29 01 00 00 00 00 0F CF 00 00 00 00 00 00 00 00 00 00 00 00 00 00
				29 01 00 00 00 00 02 00 A0
				29 01 00 00 00 00 0F CF 00 00 00 00 00 00 00 00 00 00 00 00 00 00
				29 01 00 00 00 00 02 00 B0
				29 01 00 00 00 00 0F CF 00 00 00 00 00 00 00 00 00 00 00 00 00 00
				29 01 00 00 00 00 02 00 C0
				29 01 00 00 00 00 0C CF 01 01 20 20 00 00 01 01 00 00 00
				29 01 00 00 00 00 02 00 B5
				29 01 00 00 00 00 07 C5 3c 01 ff 3c 01 ff 
                                /*29 01 00 00 00 00 02 00 91
                                29 01 00 00 00 00 02 C0 59*/
                                29 01 00 00 00 00 02 00 81
                                29 01 00 00 00 00 02 C1 66
                                29 01 00 00 00 00 02 00 83
                                29 01 00 00 00 00 02 C1 B0
                                15 01 00 00 00 00 02 5E 0C
                                29 01 00 00 00 00 02 51 00
                                29 01 00 00 00 00 02 53 24
				29 01 00 00 00 00 02 55 00
				05 01 00 00 C8 00 02 11 00
				05 01 00 00 00 00 02 29 00];
		qcom,mdss-dsi-off-command = [15 01 00 00 32 00 02 28 00
					15 01 00 00 78 00 02 10 00];
		qcom,mdss-dsi-on-command-state = "dsi_lp_mode";
		qcom,mdss-dsi-off-command-state = "dsi_hs_mode";
		qcom,mdss-dsi-h-sync-pulse = <1>;
		qcom,mdss-dsi-traffic-mode = "burst_mode";
		qcom,mdss-dsi-lane-map = "lane_map_0123";
		qcom,mdss-dsi-bllp-eof-power-mode;
		qcom,mdss-dsi-bllp-power-mode;
		qcom,mdss-dsi-lane-0-state;
		qcom,mdss-dsi-lane-1-state;
		qcom,mdss-dsi-lane-2-state;
		qcom,mdss-dsi-lane-3-state;
		qcom,mdss-dsi-panel-timings = [80 20 1A 00 3C 38 1A 20 13 03 04 00];
		qcom,mdss-dsi-t-clk-post = <0x04>;
		qcom,mdss-dsi-t-clk-pre = <0x1B>;
		qcom,mdss-dsi-bl-min-level = <1>;
		qcom,mdss-dsi-bl-max-level = <255>;
		qcom,mdss-dsi-dma-trigger = "trigger_sw";
		qcom,mdss-dsi-mdp-trigger = "none";
		qcom,mdss-dsi-bl-pmic-control-type = "bl_ctrl_dcs";
		qcom,mdss-dsi-reset-sequence = <1 10>, <0 10>, <1 10>;
                qcom,mdss-pan-physical-width-dimension = <62>; //width of picture in mm (for xdpi)
                qcom,mdss-pan-physical-height-dimension = <110>; //height of picture in mm (for ydpi)
	};
};
