// ASUS_BSP Deeo : copy from msm8916-regulator.dtsi

/* L11 regulators */
&rpm_bus {
	rpm-regulator-ldoa11 {
		status = "okay";
		pm8916_l11: regulator-l11 {
			regulator-min-microvolt = <3300000>;
			regulator-max-microvolt = <3300000>;
			qcom,init-voltage = <3300000>;
			regulator-always-on;	/* ASUS BSP Austin_T Always Enable 3.3V for vibrator */
			status = "okay";
		};
	};
};
