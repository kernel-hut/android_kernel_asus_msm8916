/* Copyright (c) 2013, The Linux Foundation. All rights reserved.
 *
 * This program is free software; you can redistribute it and/or modify
 * it under the terms of the GNU General Public License version 2 and
 * only version 2 as published by the Free Software Foundation.
 *
 * This program is distributed in the hope that it will be useful,
 * but WITHOUT ANY WARRANTY; without even the implied warranty of
 * MERCHANTABILITY or FITNESS FOR A PARTICULAR PURPOSE.  See the
 * GNU General Public License for more details.
 */

/*---------------------------------------------------------------------------
 * This file is autogenerated file using gcdb parser. Please do not edit it.
 * Update input XML file to add a new entry or update variable in this file
 * VERSION = "1.0"
 *---------------------------------------------------------------------------*/
&mdss_mdp {
	dsi_tm_otm1284a_720p_video: qcom,mdss_dsi_tm_otm1284a_720p_video {
		qcom,mdss-dsi-panel-name = "tm 720p video mode dsi panel";
		qcom,mdss-dsi-panel-controller = <&mdss_dsi0>;
		qcom,ulps-enabled;
		qcom,suspend-ulps-enabled;
		qcom,mdss-dsi-panel-type = "dsi_video_mode";
		qcom,mdss-dsi-panel-destination = "display_1";
		qcom,mdss-dsi-panel-framerate = <60>;
		qcom,mdss-dsi-virtual-channel-id = <0>;
		qcom,mdss-dsi-stream = <0>;
		qcom,mdss-dsi-panel-width = <720>;
		qcom,mdss-dsi-panel-height = <1280>;
                qcom,mdss-dsi-h-front-porch = <53>;
                qcom,mdss-dsi-h-back-porch = <64>;
                qcom,mdss-dsi-h-pulse-width = <4>;
		qcom,mdss-dsi-h-sync-skew = <0>;
                qcom,mdss-dsi-v-back-porch = <16>;
                qcom,mdss-dsi-v-front-porch = <16>;
                qcom,mdss-dsi-v-pulse-width = <4>;
		qcom,mdss-dsi-h-left-border = <0>;
		qcom,mdss-dsi-h-right-border = <0>;
		qcom,mdss-dsi-v-top-border = <0>;
		qcom,mdss-dsi-v-bottom-border = <0>;
		qcom,mdss-dsi-bpp = <24>;
		qcom,mdss-dsi-color-order = "rgb_swap_rgb";
		qcom,mdss-dsi-underflow-color = <0xff>;
		qcom,mdss-dsi-border-color = <0>;
		qcom,mdss-dsi-on-command = [29 01 00 00 00 00 02 00 90
				29 01 00 00 00 00 0D CA 9f FF 9f FF 70 FF 05 03 05 03 05 03
				29 01 00 00 00 00 02 00 00
				29 01 00 00 00 00 02 C6 10
				29 01 00 00 00 00 13 C7 a0 ab ad ab 99 aa cb cd bb 9c 88 88 67 34 33 33 33 33
				29 01 00 00 00 00 02 00 00
				29 01 00 00 00 00 02 C6 11
				29 01 00 00 00 00 13 C7 a0 ba ab ab 99 aa ba cd ab 9c 88 88 67 45 44 44 33 33
				29 01 00 00 00 00 02 00 00
				29 01 00 00 00 00 02 C6 12
				29 01 00 00 00 00 13 C7 90 ab ab ab 98 b9 b9 cc ba aa 88 88 68 45 44 44 44 44
				29 01 00 00 00 00 02 00 00
				29 01 00 00 00 00 02 C6 13
				29 01 00 00 00 00 13 C7 90 aa ab 9a 99 9a aa bb ab aa 88 88 78 56 45 44 44 44
				29 01 00 00 00 00 02 00 00
				29 01 00 00 00 00 02 C6 14
				29 01 00 00 00 00 13 C7 90 9a ab 9a 98 a9 a9 bb 9b 9a 88 88 78 56 55 55 55 45
				29 01 00 00 00 00 02 00 00
				29 01 00 00 00 00 02 C6 15
				29 01 00 00 00 00 13 C7 90 99 9b aa 98 99 99 bb aa 99 88 88 88 67 55 55 55 55
				29 01 00 00 00 00 02 00 00
				29 01 00 00 00 00 02 C6 16
				29 01 00 00 00 00 13 C7 90 99 aa 99 89 99 99 ab aa 89 88 88 88 67 66 66 55 55
				29 01 00 00 00 00 02 00 00
				29 01 00 00 00 00 02 C6 17
				29 01 00 00 00 00 13 C7 80 99 aa a8 88 99 99 aa aa 88 88 88 88 67 66 66 66 66
				29 01 00 00 00 00 02 00 00
				29 01 00 00 00 00 02 C6 18
				29 01 00 00 00 00 13 C7 80 99 a9 a8 88 89 99 9a 9a 89 88 88 88 78 67 66 66 66
				29 01 00 00 00 00 02 00 00
				29 01 00 00 00 00 02 C6 19
				29 01 00 00 00 00 13 C7 80 89 9a 98 89 98 89 9a a9 79 88 88 88 78 77 77 66 66
				29 01 00 00 00 00 02 00 00
				29 01 00 00 00 00 02 C6 1a
				29 01 00 00 00 00 13 C7 80 98 99 98 89 98 98 89 a9 89 88 88 88 78 77 77 77 66
				29 01 00 00 00 00 02 00 00
				29 01 00 00 00 00 02 C6 1b
				29 01 00 00 00 00 13 C7 70 99 a8 97 89 88 89 99 98 89 88 88 88 88 77 77 77 77
				29 01 00 00 00 00 02 00 00
				29 01 00 00 00 00 02 C6 1c
				29 01 00 00 00 00 13 C7 80 98 a8 97 89 88 89 89 99 89 88 88 88 88 77 77 77 77
				29 01 00 00 00 00 02 00 00
				29 01 00 00 00 00 02 C6 1d
				29 01 00 00 00 00 13 C7 80 88 89 98 88 98 88 89 99 88 88 88 88 88 88 78 77 77
				29 01 00 00 00 00 02 00 00
				29 01 00 00 00 00 02 C6 1e
				29 01 00 00 00 00 13 C7 80 88 98 97 88 98 88 89 98 88 88 88 88 88 88 88 78 77
				29 01 00 00 00 00 02 00 00
				29 01 00 00 00 00 02 C6 1f
				29 01 00 00 00 00 13 C7 80 88 88 98 87 98 88 88 88 89 88 88 88 88 88 88 88 78
                                29 01 00 00 00 00 02 00 00
                                29 01 00 00 00 00 02 C6 00
                                29 01 00 00 00 00 02 00 B3
                                29 01 00 00 00 00 02 C5 84
                                29 01 00 00 00 00 02 00 B1
                                29 01 00 00 00 00 02 C6 02
                                29 01 00 00 00 00 02 00 B4
                                29 01 00 00 00 00 02 C6 10
                                29 01 00 00 00 00 02 00 81
                                29 01 00 00 00 00 02 C1 66
                                29 01 00 00 00 00 02 00 83
                                29 01 00 00 00 00 02 C1 B0
                                15 01 00 00 00 00 02 5E 0C
                                29 01 00 00 00 00 02 51 00
                                29 01 00 00 00 00 02 53 24
				29 01 00 00 00 00 02 55 00
				05 01 00 00 C8 00 02 11 00
				05 01 00 00 00 00 02 29 00];
		qcom,mdss-dsi-off-command = [05 01 00 00 32 00 02 28 00
					05 01 00 00 78 00 02 10 00];
		qcom,mdss-dsi-on-command-state = "dsi_lp_mode";
		qcom,mdss-dsi-off-command-state = "dsi_hs_mode";
		qcom,mdss-dsi-h-sync-pulse = <1>;
		qcom,mdss-dsi-traffic-mode = "burst_mode";
		qcom,mdss-dsi-lane-map = "lane_map_0123";
		qcom,mdss-dsi-bllp-eof-power-mode;
		qcom,mdss-dsi-bllp-power-mode;
		qcom,mdss-dsi-lane-0-state;
		qcom,mdss-dsi-lane-1-state;
		qcom,mdss-dsi-lane-2-state;
		qcom,mdss-dsi-lane-3-state;
		qcom,mdss-dsi-panel-timings = [80 20 1A 00 3C 38 1A 20 13 03 04 00];
		qcom,mdss-dsi-t-clk-post = <0x04>;
		qcom,mdss-dsi-t-clk-pre = <0x1B>;
		qcom,mdss-dsi-bl-min-level = <1>;
		qcom,mdss-dsi-bl-max-level = <255>;
		qcom,mdss-dsi-dma-trigger = "trigger_sw";
		qcom,mdss-dsi-mdp-trigger = "none";
		qcom,mdss-dsi-bl-pmic-control-type = "bl_ctrl_dcs";
		qcom,mdss-dsi-reset-sequence = <1 10>, <0 10>, <1 10>;
                qcom,mdss-pan-physical-width-dimension = <62>; //width of picture in mm (for xdpi)
                qcom,mdss-pan-physical-height-dimension = <110>; //height of picture in mm (for ydpi)
	};
};
